.define SREG    0x3F
.define SPH     0x3E
.define SPL     0x3D
.define CCP     0x3C
.define RSTFLR  0x3B
.define SMCR    0x3A
.define OSCCAL  0x39
;.define rsvd   0x38
.define CLKMSR  0x37
.define CLKPSR  0x36
.define PRR     0x35
.define VLMCSR  0x34
.define NVMCMD  0x33
.define NVMCSR  0x32
.define WDTCSR  0x31
;.define rsvd   0x30
.define GTCCR   0x2F
.define TCCR0A  0x2E
.define TCCR0B  0x2D
.define TCCR0C  0x2C
.define TIMSK0  0x2B
.define TIFR0   0x2A
.define TCNT0H  0x29
.define TCNT0L  0x28
.define OCR0AH  0x27
.define OCR0AL  0x26
.define OCR0BH  0x25
.define OCR0BL  0x24
.define ICR0H   0x23
.define ICR0L   0x22
;.define rsvd   0x21
;.define rsvd   0x20
.define ACSR    0x1F
;.define rsvd   0x1E
.define ADCSRA  0x1D
.define ADCSRB  0x1C
.define ADMUX   0x1B
;.define rsvd   0x1A
.define ADCL    0x19
;.define rsvd   0x18
.define DIDR0   0x17
;.define rsvd   0x16
.define EICRA   0x15
.define EIFR    0x14
.define EIMSK   0x13
.define PCICR   0x12
.define PCIFR   0x11
.define PCMSK   0x10
;.define rsvd   0x0F
;.define rsvd   0x0E
;.define rsvd   0x0D
.define PORTCR  0x0C
;.define rsvd   0x0B
;.define rsvd   0x0A
;.define rsvd   0x09
;.define rsvd   0x08
;.define rsvd   0x07
;.define rsvd   0x06
;.define rsvd   0x05
;.define rsvd   0x04
.define PUEB    0x03
.define PORTB   0x02
.define DDRB    0x01
.define PINB    0x00
